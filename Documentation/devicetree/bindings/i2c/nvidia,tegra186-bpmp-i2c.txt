## Documentation/devicetree/bindings/i2c/nvidia,tegra186-bpmp-i2c.txt
```
NVIDIA Tegra186 BPMP I2C controller proxy driver.

The BPMP is the boot and power management processor embedded in Tegra SoCs.
Access to one of the I2C busses goes via the BPMP, requiring a different
'virtual' i2c driver that accesses the bus via the real i2c driver embedded
in the BPMP firmware. The binding document defines the resources/properties
that would be used by the BPMP I2c proxy driver.

Required properties:
- compatible : Should be "nvidia,tegra186-bpmp-i2c"
- nvidia,bpmp: This property must contain entry of bpmp node
- nvidia,bpmp-bus-id: Should be BPMP I2C bus id used by bpmp firmware i2c driver
- #address-cells: Address cells for I2C device address, should be 1
- #size-cells: Size of the I2C device address, should be 0

Example:
	bpmp_i2c: i2c {
		compatible = "nvidia,tegra186-bpmp-i2c";
		nvidia,bpmp = <&bpmp>;
		nvidia,bpmp-bus-id = <5>;
		#address-cells = <1>;
		#size-cells = <0>;
		status = "disabled";
	};
```

## Documentation/devicetree/bindings/panel/sharp,lq101r1sx01.txt
```
Sharp Microelectronics 10.1" WQXGA TFT LCD panel

This panel requires dual-channel DSI to operate. It supports two modes:
- left-right: the two channels drive the left or right halves of the screen
- odd-even: the two channels drive the odd or even lines of the screen

Each of the DSI channels drives a separate DSI peripheral. The left (or odd)
peripheral is considered the primary peripheral and controls the device. The
phandle to the right (or even) peripheral is specified in a property called
"secondary".

Required properties:
- compatible: should be "sharp,lq101r1sx01"
- secondary: phandle of the DSI peripheral that is the second link
- power-supply: phandle of the regulator that provides the supply voltage

Optional properties:
- backlight: phandle of the backlight device attached to the panel
```

## drivers/gpu/drm/gamecube/Kconfig
```kconfig
config DRM_GAMECUBE
	bool "gamecube"
	depends on GAMECUBE_COMMON
	depends on DRM
	select DRM_KMS_HELPER
	help
	  Choose this option if you have a Nintendo GameCube or Nintendo Wii.

if DRM_GAMECUBE

config DRM_GAMECUBE_FBDEV
	bool "Enable legacy fbdev support"
	select DRM_KMS_FB_HELPER
	select FB_SYS_FILLRECT
	select FB_SYS_COPYAREA
	select FB_SYS_IMAGEBLIT
	default y
	help
	  Choose this option if you have a need for the legacy fbdev support.
	  Note that this support also provides the Linux console on top of
	  the GameCube modesetting driver.

endif
```
